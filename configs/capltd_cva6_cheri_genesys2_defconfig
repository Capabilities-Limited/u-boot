## configs/capltd_cva6_cheri_genesys2_defconfig
```kconfig
CONFIG_RISCV=y
CONFIG_SYS_MALLOC_LEN=0x00800000
CONFIG_NR_DRAM_BANKS=1
CONFIG_HAS_CUSTOM_SYS_INIT_SP_ADDR=y
CONFIG_CUSTOM_SYS_INIT_SP_ADDR=0x80200000
CONFIG_DEFAULT_DEVICE_TREE="cv64a6_imafdc_zcheri_sv39"
CONFIG_SYS_BOOTM_LEN=0x08000000
CONFIG_SYS_LOAD_ADDR=0xa0000000
CONFIG_STACK_SIZE_SHIFT=15
CONFIG_TARGET_OPENHWGROUP_CVA6_GENESYSII=y
CONFIG_ARCH_RV64I=y
CONFIG_RISCV_SMODE=y
CONFIG_BOOTDELAY=3
CONFIG_DISTRO_DEFAULTS=y
CONFIG_PREBOOT="setenv fdt_addr ${fdtcontroladdr}; fdt addr ${fdtcontroladdr};"
CONFIG_USE_PREBOOT=y
CONFIG_BOOTCOMMAND="mmc info; fatload mmc 0:2 0xa0000000 /fitImage.itb; bootm 0xa0000000"
CONFIG_CMD_TIMER=y
CONFIG_DISPLAY_CPUINFO=y
CONFIG_CMD_GPT=y
CONFIG_CMD_MMC=y
CONFIG_CMD_PART=y
CONFIG_CMD_DHCP=y
CONFIG_CMD_MDIO=y
CONFIG_CMD_PING=y
CONFIG_CMD_FAT=y
CONFIG_OF_BOARD=y
CONFIG_OF_OMIT_DTB=y
#CONFIG_ENV_IS_IN_FAT=y
#CONFIG_ENV_FAT_DEVICE_AND_PART="0:1"
CONFIG_NET_RANDOM_ETHADDR=y
CONFIG_DM_I2C=y
CONFIG_SYS_I2C_OCORES=y
CONFIG_I2C_EEPROM=y
CONFIG_SPI_FLASH_SPANSION=y
CONFIG_PHY_MSCC=y
CONFIG_PHY_TI_DP83867=y
CONFIG_XILINX_AXIEMAC=y
CONFIG_XILINX_EMACLITE=y
CONFIG_SYS_NS16550=y
CONFIG_XILINX_SPI=y
#CONFIG_EFI_LOADER is not set
CONFIG_EFI_LOADER=n
CONFIG_SPI=y
CONFIG_MMC=y
CONFIG_MMC_SPI=y
CONFIG_DISPLAY_CPUINFO=y
CONFIG_FIT=y
#CONFIG_ENV_OVERWRITE=y
CONFIG_USE_BOOTFILE=y
CONFIG_BOOTFILE="fitImage.itb"
CONFIG_PHY_REALTEK=y
#CONFIG_LOWRISC_DIGILENT_100MHZ=y

CONFIG_RISCV_ISA_ZCHERIPURECAP=y
CONFIG_RISCV_ISA_ZCHERIHYBRID=y
CONFIG_RISCV_ISA_ZCHERIPURECAP_ABI=y
```

## configs/lowrisc_mocha_defconfig
```kconfig
CONFIG_RISCV=y
CONFIG_RISCV_ISA_ZICBOM=n
CONFIG_SYS_MALLOC_LEN=0x00800000
CONFIG_NR_DRAM_BANKS=1
CONFIG_HAS_CUSTOM_SYS_INIT_SP_ADDR=y
CONFIG_CUSTOM_SYS_INIT_SP_ADDR=0x80200000
CONFIG_DEFAULT_DEVICE_TREE="lowrisc_mocha"
CONFIG_SYS_BOOTM_LEN=0x08000000
CONFIG_SYS_LOAD_ADDR=0xa0000000
CONFIG_STACK_SIZE_SHIFT=15
CONFIG_TARGET_LOWRISC_MOCHA=y
CONFIG_ARCH_RV64Y=y
CONFIG_RISCV_SMODE=y
CONFIG_BOOTDELAY=3
CONFIG_DISTRO_DEFAULTS=y
CONFIG_PREBOOT="setenv fdt_addr ${fdtcontroladdr}; fdt addr ${fdtcontroladdr};"
CONFIG_USE_PREBOOT=y
CONFIG_BOOTCOMMAND="mmc info; fatload mmc 0:2 0xa0000000 /fitImage.itb; bootm 0xa0000000"
CONFIG_DM_GPIO=y
CONFIG_DM_SERIAL=y
CONFIG_DM_SPI=y
CONFIG_DM_I2C=y
CONFIG_MMC=y
CONFIG_MMC_SPI=y
CONFIG_FS_EXT4=y
CONFIG_FS_FAT=y
CONFIG_CMD_TIMER=y
CONFIG_DISPLAY_CPUINFO=y
CONFIG_CMD_GPT=y
CONFIG_CMD_MMC=y
CONFIG_CMD_PART=y
CONFIG_CMD_DHCP=y
CONFIG_CMD_MDIO=y
CONFIG_CMD_PING=y
CONFIG_CMD_FAT=y
CONFIG_OF_BOARD=y
CONFIG_OF_OMIT_DTB=y
#CONFIG_EFI_LOADER is not set
CONFIG_EFI_LOADER=n
CONFIG_SPI=y
CONFIG_MMC=y
CONFIG_MMC_SPI=y
CONFIG_DISPLAY_CPUINFO=y
CONFIG_FIT=y
#CONFIG_ENV_OVERWRITE=y
CONFIG_USE_BOOTFILE=y
CONFIG_BOOTFILE="fitImage.itb"
```
